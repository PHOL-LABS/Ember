## ESP32/Ember/sdkconfig.defaults
```kconfig
CONFIG_IDF_TARGET="esp32"
CONFIG_PARTITION_TABLE_CUSTOM=y
CONFIG_PARTITION_TABLE_CUSTOM_FILENAME="partitions.csv"
CONFIG_DEFAULT_AP_ESP_WIFI_SSID="Ember_AP"
CONFIG_DEFAULT_AP_ESP_WIFI_PASS="configureme"
```
